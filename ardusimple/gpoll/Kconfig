## ardusimple/gpoll/Kconfig
```kconfig
#
# For a description of the syntax of this configuration file,
# see the file kconfig-language.txt in the NuttX tools repository.
#

config ARDUSIMPLE_GPOLL
	bool "GPS message poll application"
	default n
	---help---
		Poll GPS messages using named FIFO.

if ARDUSIMPLE_GPOLL

config ARDUSIMPLE_GPOLL_FIFO
	string "FIFO name"
	default "/var/gps0"

config ARDUSIMPLE_GPOLL_PROGNAME
	string "Program name"
	default "as_gpoll"
	---help---
		This is the name of the program that will be used when the NSH ELF
		program is installed.

config ARDUSIMPLE_GPOLL_PRIORITY
	int "Task priority"
	default 100

config ARDUSIMPLE_GPOLL_STACKSIZE
	int "Stack size"
	default DEFAULT_TASK_STACKSIZE

endif
```

## ardusimple/uorbd/Kconfig
```kconfig
#
# For a description of the syntax of this configuration file,
# see the file kconfig-language.txt in the NuttX tools repository.
#

config ARDUSIMPLE_UORBD
	bool "uORB Daemon"
	default n
	---help---
		Collect necessary data from uORB topics and direct to the HTTP server.

if ARDUSIMPLE_UORBD

config ARDUSIMPLE_UORBD_PROGNAME
	string "Program name"
	default "uorbd"
	---help---
		This is the name of the program that will be used when the NSH ELF
		program is installed.

config ARDUSIMPLE_UORBD_PRIORITY
	int "uORB Daemon task priority"
	default 100

config ARDUSIMPLE_UORBD_STACKSIZE
	int "uORB Daemon stack size"
	default DEFAULT_TASK_STACKSIZE

endif
```

## examples/mongoose/Kconfig
```kconfig
#
# For a description of the syntax of this configuration file,
# see the file kconfig-language.txt in the NuttX tools repository.
#

config EXAMPLES_MONGOOSE
	tristate "Mongoose examples"
	default n
	depends on NETUTILS_MONGOOSE
	---help---
		Enable the Mongoose examples.

if EXAMPLES_MONGOOSE

config EXAMPLES_MONGOOSE_HTTPD
	tristate "Mongoose Web server"
	default n
	depends on NETUTILS_MONGOOSE
	---help---
		Enable the Mongoose web server example.

config EXAMPLES_MONGOOSE_WEBSOCKD
	tristate "Mongoose Websocket server"
	default n
	depends on NETUTILS_MONGOOSE
	---help---
		Enable the Mongoose websocket server example.

config EXAMPLES_MONGOOSE_SMARTANT
	tristate "Mongoose Smart Antenna server"
	default n
	depends on NETUTILS_MONGOOSE
	---help---
		Enable the Mongoose smart antenna server example.

if EXAMPLES_MONGOOSE_SMARTANT

choice
	prompt "GPS message type"
	default EXAMPLES_MONGOOSE_SMARTANT_UORB

config EXAMPLES_MONGOOSE_SMARTANT_UORB
	bool "Use uORB"
	select UORB

config EXAMPLES_MONGOOSE_SMARTANT_FIFO
	bool "Use FIFO"
  select PIPES

endchoice # GPS message type

endif # EXAMPLES_MONGOOSE_SMARTANT

config EXAMPLES_MONGOOSE_PRIORITY
	int "Mongoose task priority"
	default 100

config EXAMPLES_MONGOOSE_STACKSIZE
	int "Mongoose stack size"
	default 8192

config EXAMPLES_MONGOOSE_IPADDR
	hex "Device IP"
	default 0x0a000014
	---help---
		This is the IP address of your board.

config EXAMPLES_MONGOOSE_DRIPADDR
	hex "Default Router IP"
	default 0x0a000001
	---help---
		This is the IP address of your router/gateway.

config EXAMPLES_MONGOOSE_NETMASK
	hex "Network Mask"
	default 0xffffff00
	---help---
		This is the network mask to use on this device.

endif
```

## examples/ntrip/Kconfig
```kconfig
#
# For a description of the syntax of this configuration file,
# see the file kconfig-language.txt in the NuttX tools repository.
#

config EXAMPLES_NTRIP
	tristate "NTRIP example"
	default n
	depends on NET && NET_TCP
	---help---
		Enable the NTRIP test example

if EXAMPLES_NTRIP

config EXAMPLES_NTRIP_CLIENT_STACKSIZE
	int "NTRIP Client stack size"
	default 4096
	---help---
		This is the stack size allocated when the NTRIP client task runs

config EXAMPLES_NTRIP_CLIENT_PRIORITY
	int "NTRIP Client task priority"
	default 100
	---help---
		This is the priority of the NTRIP client task

config EXAMPLES_NTRIP_CLIENT_PROGNAME
	string "NTRIP Client program name"
	default "ntripc"
	---help---
		This is the name of the program that will be used when the NSH ELF
		NTRIP client program is installed.

endif # EXAMPLES_NTRIP
```

## netutils/mongoose/Kconfig
```kconfig
#
# For a description of the syntax of this configuration file,
# see the file kconfig-language.txt in the NuttX tools repository.
#

config NETUTILS_MONGOOSE
	bool "Mongoose library"
	default n
	---help---
		Mongoose is a network library for C/C++. It provides event-driven 
		non-blocking APIs for TCP, UDP, HTTP, WebSocket, MQTT, and other 
		protocols.

if NETUTILS_MONGOOSE

config MONGOOSE_VERSION
	string "Mongoose Version"
	default "7.14"

endif # NETUTILS_MONGOOSE
```
